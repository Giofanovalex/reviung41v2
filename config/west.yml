## config/west.yml
```yaml
manifest:
  remotes:
    # Adding a comment to invalidate cache
    - name: zmkfirmware
      url-base: https://github.com/zmkfirmware
  projects:
    - name: zmk
      remote: zmkfirmware
      revision: main
      import: app/west.yml
  self:
    path: config
```
